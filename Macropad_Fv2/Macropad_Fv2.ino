#include <Keyboard.h>
#include <Wire.h>
#include <Adafruit_GFX.h>
#include <Adafruit_SSD1306.h>
#include <Mouse.h>

#include "Key_commands.h"


Adafruit_SSD1306 display(128, 64, &Wire, -1);


/*
abc
def
*/
#define a 4
#define b 5
#define c 6
#define d 7
#define e 8
#define f 9

/*
    t1
    t2
con t3
*/
#define con 10
#define t1 15
#define t2 14
#define t3 16
#define ps A0

// -----------------------------------bitmaps-------------------------------

// 'Logo', 128x64px
const unsigned char epd_bitmap_Logo [] PROGMEM = {
		0x00, 0x00, 0x00, 0x00, 0x00, 0x00, 0x00, 0x00, 0x00, 0x00, 0x00, 0x00, 0x00, 0x00, 0x00, 0x00, 
	0x00, 0x00, 0x00, 0x00, 0x00, 0x00, 0x00, 0x00, 0x00, 0x00, 0x00, 0x00, 0x00, 0x00, 0x00, 0x00, 
	0x00, 0x00, 0x00, 0x00, 0x00, 0x00, 0x00, 0x00, 0x04, 0x40, 0x00, 0x00, 0x00, 0x00, 0x00, 0x00, 
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	0x00, 0x00, 0x00, 0x00, 0x00, 0x00, 0x00, 0x00, 0x00, 0x00, 0x00, 0x00, 0x00, 0x00, 0x00, 0x00
  };
// 'bongocat1', 128x64px
const unsigned char epd_bitmap_bongocat1 [] PROGMEM = {
	0xff, 0xff, 0xff, 0xff, 0xff, 0xff, 0xff, 0xff, 0xff, 0xff, 0xff, 0xff, 0xff, 0xff, 0xff, 0xff, 
	0xff, 0xff, 0xff, 0xff, 0xff, 0xff, 0xff, 0xff, 0xff, 0xff, 0xff, 0xff, 0xff, 0xff, 0xff, 0xff, 
	0xff, 0xff, 0xff, 0xff, 0xff, 0xff, 0xff, 0xff, 0xff, 0xff, 0xff, 0xff, 0xff, 0xff, 0xff, 0xff, 
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	0xff, 0xff, 0xff, 0xff, 0xff, 0xff, 0xff, 0xff, 0xff, 0xff, 0xff, 0xff, 0xff, 0xff, 0xff, 0xff
  };
// 'bongocat2', 128x64px
const unsigned char epd_bitmap_bongocat2 [] PROGMEM = {
	0xff, 0xff, 0xff, 0xff, 0xff, 0xff, 0xff, 0xff, 0xff, 0xff, 0xff, 0xff, 0xff, 0xff, 0xff, 0xff, 
	0xff, 0xff, 0xff, 0xff, 0xff, 0xff, 0xff, 0xff, 0xff, 0xff, 0xff, 0xff, 0xff, 0xff, 0xff, 0xff, 
	0xff, 0xff, 0xff, 0xff, 0xff, 0xff, 0xff, 0xff, 0xff, 0xff, 0xff, 0xff, 0xff, 0xff, 0xff, 0xff, 
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	0xff, 0xff, 0xff, 0xff, 0xff, 0xff, 0xff, 0xff, 0xff, 0xff, 0xff, 0xff, 0xff, 0xff, 0xff, 0xff
  };
//


const int epd_bitmap_allArray_LEN = 3;
const unsigned char* epd_bitmap_allArray[3] = {
	epd_bitmap_Logo,
	epd_bitmap_bongocat1,
	epd_bitmap_bongocat2,
};





int prst = 0;






void setup() {

  Serial.begin(9600);
  display.begin(SSD1306_SWITCHCAPVCC, 0x3C);
  display.clearDisplay();
  display.drawBitmap(0,0, epd_bitmap_Logo,128,64,1);
  display.display();

  delay(1000); //Startup loader
  display.clearDisplay();
  pinMode (4, INPUT_PULLUP);
  pinMode (5, INPUT_PULLUP);
  pinMode (6, INPUT_PULLUP);
  pinMode (7, INPUT_PULLUP);
  pinMode (8, INPUT_PULLUP);
  pinMode (9, INPUT_PULLUP);

  pinMode (10, INPUT_PULLUP);
  pinMode (16, INPUT_PULLUP);
  pinMode (14, INPUT_PULLUP);
  pinMode (15, INPUT_PULLUP);

  pinMode (A0, INPUT_PULLUP);

}





void loop() {

  switch (prst) {
  case 1:
  preset1();
  break;


  case 2:
  preset2();
  break;


  case 3: 
 if (digitalRead(ps) == LOW)
{
  upps();
  delay(300);
  }
  break;



  default:
  prst = 1;
  }
}

// update preset for display
void upps()
{
if (prst < 3)
  {
  prst++;
  Serial.print(prst);
  updisplay();
  } else {
  prst = 1;
  Serial.print(prst);
  updisplay();
  }
}



// update display
void updisplay() 
{
  static bool upds = false;
switch (prst) {
  
  case 1:
  if (upds == false) {  
    display.clearDisplay();
    display.drawBitmap(0, 0, epd_bitmap_bongocat1, 128, 64, 1);
    display.display();
    upds = !upds;
  } else {
    display.clearDisplay();
    display.drawBitmap(0, 0, epd_bitmap_bongocat2, 128, 64, 1);
    display.display();
    upds = !upds;
  }
  break;

  case 2:
  if (upds == false) {
    display.clearDisplay();
    display.drawBitmap(0, 0, epd_bitmap_Logo, 128, 64, 1);
    display.display();
    upds = !upds;
  } else{
    display.clearDisplay();
    display.display();
    upds = !upds;
  }
  break;

  case 3:
  if (upds == false) {
    display.clearDisplay();
    display.drawBitmap(0, 0, epd_bitmap_Logo, 128, 64, 1);
    display.display();
    upds = !upds;
  } else{
    display.clearDisplay();
    display.display();
    upds = !upds;
  }
  break;

  }
}






